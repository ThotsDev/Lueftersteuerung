## sdkconfig.defaults
```kconfig
# ESP32-D0WD-V3 with 4 MiB flash confirmed via esptool on 2026-11-07.
CONFIG_ESPTOOLPY_FLASHSIZE_4MB=y
CONFIG_PARTITION_TABLE_CUSTOM=y
CONFIG_PARTITION_TABLE_CUSTOM_FILENAME="partitions.csv"
CONFIG_PARTITION_TABLE_OFFSET=0xC000
CONFIG_BT_ENABLED=y
CONFIG_BT_NIMBLE_ENABLED=y
CONFIG_ENABLE_CHIPOBLE=y
CONFIG_ENABLE_WIFI_STATION=y
CONFIG_ENABLE_WIFI_AP=n
CONFIG_ESP_WIFI_SOFTAP_SUPPORT=n
CONFIG_LWIP_IPV6=y
CONFIG_LWIP_IPV6_AUTOCONFIG=y
CONFIG_LWIP_IPV6_NUM_ADDRESSES=6
CONFIG_LWIP_HOOK_IP6_ROUTE_DEFAULT=y
CONFIG_LWIP_HOOK_ND6_GET_GW_DEFAULT=y
CONFIG_MBEDTLS_HKDF_C=y
CONFIG_ENABLE_CHIP_SHELL=y
CONFIG_SUPPORT_FAN_CONTROL_CLUSTER=y
CONFIG_ENABLE_OTA_REQUESTOR=n
CONFIG_ESP_MATTER_MAX_DYNAMIC_ENDPOINT_COUNT=2
```
